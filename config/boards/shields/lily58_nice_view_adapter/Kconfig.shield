## config/boards/shields/nice_view_lily/Kconfig.defconfig
```kconfig
# Based on ZMK's nice_view shield (MIT)

if SHIELD_NICE_VIEW_LILY

config LV_Z_VDB_SIZE
    default 100

config LV_DPI_DEF
    default 161

config LV_Z_BITS_PER_PIXEL
    default 1

choice LV_COLOR_DEPTH
    default LV_COLOR_DEPTH_1
endchoice

choice ZMK_DISPLAY_WORK_QUEUE
    default ZMK_DISPLAY_WORK_QUEUE_DEDICATED
endchoice

choice ZMK_DISPLAY_STATUS_SCREEN
    default ZMK_DISPLAY_STATUS_SCREEN_CUSTOM
endchoice

config LV_Z_MEM_POOL_SIZE
    default 4096 if ZMK_DISPLAY_STATUS_SCREEN_CUSTOM

config ZMK_DISPLAY_STATUS_SCREEN_CUSTOM
    imply NICE_VIEW_LILY_SCREEN

config NICE_VIEW_LILY_SCREEN
    bool "Lily58 nice!view screens (Amp + slideshow)"
    select LV_USE_IMG
    select LV_USE_CANVAS

if !ZMK_SPLIT || ZMK_SPLIT_ROLE_CENTRAL

config NICE_VIEW_LILY_SCREEN
    select ZMK_WPM

endif # !ZMK_SPLIT || ZMK_SPLIT_ROLE_CENTRAL

config NICE_VIEW_LILY_SLIDE_MS
    int "How long each slideshow picture stays up, in ms"
    default 10000

config NICE_VIEW_LILY_TRANSITION_MS
    int "Length of the rain drip transition, in ms"
    default 1600

endif # SHIELD_NICE_VIEW_LILY
```

## config/dts/bindings/behaviors/sina,behavior-glow.yaml
```yaml
description: Underglow colour and effect, separate from the key lights

compatible: "sina,behavior-glow"

include: two_param.yaml
```

## config/dts/bindings/sina,led-strip-zones.yaml
```yaml
description: |
  Sits between ZMK's RGB underglow and the real LED strip. Passes ZMK's frames
  through, recolours the underglow LEDs with the "glow" colour/effect, and
  blanks everything while lights are not allowed (idle on battery).

compatible: "sina,led-strip-zones"

properties:
  led-strip:
    type: phandle
    required: true
    description: The real LED strip to drive.
  chain-length:
    type: int
    required: true
    description: Number of LEDs, same as the real strip's chain-length.
  underglow-indices:
    type: array
    required: true
    description: Chain positions of the underglow LEDs.
```
